## base_external/package/ldd/Config.in
```kconfig
config BR2_PACKAGE_LDD
	bool "ldd"
	help
	  Building and installing misc-modules and scull components into the root filesystem.
	  Adding package to image.
```
